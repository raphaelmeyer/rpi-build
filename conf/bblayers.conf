## conf/bblayers.conf
```bitbake
# LAYER_CONF_VERSION is increased each time build/conf/bblayers.conf
# changes incompatibly
LCONF_VERSION = "6"

BBPATH = "${TOPDIR}"
BBFILES ?= ""

BBLAYERS ?= " \
  /workspace/poky/meta \
  /workspace/poky/meta-yocto \
  /workspace/poky/meta-yocto-bsp \
  /workspace/meta-raspberrypi \
  /workspace/meta-ybpi \
  "
BBLAYERS_NON_REMOVABLE ?= " \
  /workspace/poky/meta \
  /workspace/poky/meta-yocto \
  "
```

## conf/local.conf
```bitbake
# Raspberry Pi

MACHINE ?= "raspberrypi2"

GPU_MEM = "256"
VIDEO_CAMERA = "1"
ENABLE_SPI_BUS = "1"
ENABLE_I2C = "1"

DISTRO ?= "poky"

PACKAGE_CLASSES ?= "package_ipk"

EXTRA_IMAGE_FEATURES = "\
  debug-tweaks \
  package-management \
  ssh-server-dropbear"

USER_CLASSES ?= "buildstats image-mklibs image-prelink"

PATCHRESOLVE = "noop"

BB_DISKMON_DIRS = "\
    STOPTASKS,${TMPDIR},1G,100K \
    STOPTASKS,${DL_DIR},1G,100K \
    STOPTASKS,${SSTATE_DIR},1G,100K \
    ABORT,${TMPDIR},100M,1K \
    ABORT,${DL_DIR},100M,1K \
    ABORT,${SSTATE_DIR},100M,1K" 

CONF_VERSION = "1"
```
